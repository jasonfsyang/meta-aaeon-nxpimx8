## conf/layer.conf
```bitbake
# We have a conf and classes directory, add to BBPATH
BBPATH .= ":${LAYERDIR}"

# We have recipes-* directories, add to BBFILES
BBFILES += "${LAYERDIR}/recipes-*/*/*.bb \
            ${LAYERDIR}/recipes-*/*/*.bbappend"

BBFILE_COLLECTIONS += "meta-aaeon-imx8p"
BBFILE_PATTERN_meta-aaeon-imx8p = "^${LAYERDIR}/"
BBFILE_PRIORITY_meta-aaeon-imx8p = "6"

LAYERDEPENDS_meta-aaeon-imx8p = "core"
LAYERSERIES_COMPAT_meta-aaeon-imx8p = "kirkstone"
```
